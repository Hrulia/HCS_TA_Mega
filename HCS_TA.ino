/*
    Name:       HCS_TA.ino
    Created:	19.08.2019 11:42:45
    Author:     Serega_nout\Sergey
*/

///#include "Pins.h"   //тут собраны все пины.
#include "HeaderHCS_TA.h"
#include "ValvesAndPumpsController.h"
#include "Temp_DS18B20.h"
#include "Indicator_TM1637.h"


GlobalParametersStructure globalParameters;		// Объект для хранения глобальных переменных системы
MegaParametersStruct systemParameters;				// Объект, содержащий текущие системные параметры
EEManager memory(systemParameters);						// менеджер EEPROM. Передаём нашу переменную (фактически её адрес)


// Cycles
	myCycle cycleDispSystemTime(MS_250, true);		//0,25 сек. Вывод информации о системном времени на индикатор ТМ1637
	myCycle cycleGetTemp(MS_13S, true);						//15c, 5c цикл считывания температуры (MS_05S)
	myCycle cycleDispTempTM1637(MS_03S, true);		//2c, 150мc цикл обновления показаний температуры на индикаторах TM1637, такая частось, чтобы точки на индикаторе часов "тикали", мигали плавно каждую секунду 
	myCycle cycleTempControlTTK(MS_10S, true);		//8.5c, при 6 сек. показания термопары 0гр. Цикл запуска управления трехходовым краном ТТК (защита от холодной обратки)
	myCycle cycleTempControlSYS(MS_03M, true);		//MS_30S//last 3min  была 60 cделал 180. 60с цикл запуска управления трехходовым краном системы 
	myCycle cyclecheckMegaAndESP(MS_01M, true);			//1мин цикл отправки в esp через serial3 команды своего присутствия: ?mega=1 и проверки поступления команды присутствия ESP
	myCycle cyclecheckMegaAndESP(MS_01M, true);			//1мин цикл отправки в esp через serial3 команды своего присутствия: ?mega=1 и проверки поступления команды присутствия ESP
	myCycle cycleDoorAirControl(MS_03M, true);			// Цикл вызова процедуры управления дверкой поддувала



//включение отладки в основном модуле программы/* Оформление отладки как у Алекса Гайвера*/
#define DEBUG_ENABLE_MAIN
#ifdef DEBUG_ENABLE_MAIN
#define DEBUG_PRINT_MAIN(x) (Serial.print(x))
#define DEBUG_PRINTLN_MAIN(x) (Serial.println(x))
#define DEBUGR_PRINTR_MAIN(x,r) (Serial.print(x,r))
#else
#define DEBUG_PRINT_MAIN(x) 
#define DEBUG_PRINTLN_MAIN(x) 
#define DEBUGR_PRINTR_MAIN(x,r) 
#endif // DEBUG_ENABLE_MAIN


	void setup()
{
	unsigned long startTime = millis();
	Serial.begin(MAIN_UART_SPEED);
	DEBUG_PRINTLN_MAIN(F("\n******* SETUP(): START ***********"));
	
	//Вывод светодиода на плате
	pinMode(LED_BUILTIN, OUTPUT);
	//pinMode(46, OUTPUT);
	//digitalWrite(46, HIGH);

	//Выход подачи сигнала сброса ESP
	pinMode(PIN_RESET_ESP, OUTPUT); digitalWrite(PIN_RESET_ESP, HIGH);

	//настраиваем порты и устанавливаем начальные сигналы
	initPortsValvesAndPumps();
	
	//Считываем параметры из памяти EEPROM
	///retryReadEEPROM:
		// Запускаем менеджер EEPROM, передаём: - Стартовый адрес в памяти для записи данных; - Ключ хранения (0.. 255) или символ
		byte stat = memory.begin(1, 'a');
		DEBUG_PRINTLN_MAIN("Результата чтения данных из EEPROM: "+String(stat)+F(". (0 - ключ совпал, данные прочитаны из епром;	1 - ключ не совпал (первый запуск), данные записаны в епром;	2 - ошибка, в епроме не хватает места)"));
		/* Коды возврата:	0 - ключ совпал, данные прочитаны из епром;	1 - ключ не совпал (первый запуск), данные записаны в епром;	2 - ошибка, в епроме не хватает места */
		Serial.println("Данные из EEPROM: ");
		Serial.print("RoomSetPointTemperature: "); Serial.println(systemParameters.RoomSetPointTemperature);

		//Serial.println(String("roomSetPointTemp: ")); Serial.print(systemParameters.RoomSetPointTemperature);
		//systemParameters.RoomSetPointTemperature = 24.2;
		Serial.print("SystemPumpMode: "); Serial.println(systemParameters.SystemPumpMode); 
		Serial.print("TTKPumpMode: "); Serial.println(systemParameters.TTKPumpMode);

		//Случился, сбой, поэтому введем сброс памяти при старте с нажатой кнопкой.
		//инициализируем пин кнопки, что бы можно было ее использовать. Вообще-то пин инициализируется в классе button, но думаю если раньше, то не повредит. 
		pinMode(PIN_BUTTON, INPUT_PULLUP);

		if (!(digitalRead(PIN_BUTTON))) {
			Serial.println("Старт c нажатой кнопкой. Сбрасываем настройки, на значения по умолчанию (memory.reset)");
			memory.reset();
			Serial.println("выполнен memory.reset. При следующей загрузки устройства будут загружены параметры по умолчанию. Нажми Reset");
			//повторно вызываем begin
			////goto retryReadEEPROM;
		}



	//инициализация RTC
	initSystemTime();

	//инициализация индикаторов TM1637
	init_TM1637(); //void

	//Инициализация датчиков температуры
	initTemp(); 

	//Тестирование моторизированных кранов
	testValves(); 

	//Настройка rx3/tx3 интерфейса
	initRxTxForNetSharing(TO_ESP_UART_SPEED);

	//Настройка rx2/tx2 интерфейса. Тестовый прием от Serial3
	//initRxTxForNetSharing2(115200);

	DEBUG_PRINTLN_MAIN(F("setup(): Stop"));
}

// Add the main program code into the continuous loop() function
void loop()
{
	unsigned long startTime = millis();
	//DEBUG_PRINTLN_MAIN("\nloop(): Start\n");
	int result = 0; //коды завершения вызываемых функций

	//ShowFPS(); //подсчет количества циклов loop за одну секунду.

	// Обновление информации в EEPROM. В вызове tick() по таймеру произойдёт обновление, функция вернёт true, когда это случится
	if (memory.tick()) Serial.println("loop(): Updated EEPROM!");

	//обновление информации о системном времени на TM1637
	if (cycleDispSystemTime.check()) {
		result = indicator_TM1637_Output_time();
		if (result) {
			DEBUG_PRINTLN_MAIN("Error in indicator_TM1637_Output_time "+String(result)+F("\n"));
			//обработка ошибки
			//...
		}
	}

	//обновление информации с датчиков температуры
	if (cycleGetTemp.check()) {
		uint16_t result = getTemperaturDS18B20();
		if (result) {
			DEBUG_PRINTLN_MAIN("Error in getTemperaturDS18B20 " + String(result) + "\n");
			//обработка ошибки
			//...
		}
	}

	//Обновление информации о температуре на индикаторах TM1637
	if (cycleDispTempTM1637.check()) {
		result = indicator_TM1637_Output_temperature();
		if (result) {
			DEBUG_PRINTLN_MAIN("Error in indicator_TM1637_Output_temperature " + String(result) + "\n");
			//обработка ошибки
			//...
		} 
	}

	//управление краном ТТК (защита от холодной обратки)
	if (cycleTempControlTTK.check()) {
		result = temperatureControlTTK();
		if (result) {
			DEBUG_PRINTLN_MAIN("Error in temperatureControlTTK " + String(result) + "\n");
			//обработка ошибки
			//...
		}
	}

	//управление краном системы
	if (cycleTempControlSYS.check()) {
		result = temperatureControlSYS();
		if (result) {
			DEBUG_PRINTLN_MAIN("Error in temperatureControlSYS " + String(result) + "\n");
			//обработка ошибки
			//...
		}
	}

	//управление дверкой поддувала
	if (cycleDoorAirControl.check()) {
		void doorAirControl();
	}


	// Обработка запросов поступающих от модуля ESP8266
		checkSerial();  //проверяем поступление команды от ESP в порт uart Serial3 

	// отпарвки команды своего присутствия на ESP через Serial3
	if (cyclecheckMegaAndESP.check()) {
		checkMegaAndESP();  //Отправка на модуль ESP команды о своем нормальном функционировании. Проверка нормального функционирования ESP.
		// перезапуск таймера вызова функции.
		cyclecheckMegaAndESP.clear();
		cyclecheckMegaAndESP.reStart();
	}

	digitalWrite(LED_BUILTIN, (digitalRead(LED_BUILTIN)?LOW:HIGH));  //Мигнем встроенным светодиодом по окончании цикла loop
	//	DEBUG_PRINTLN_MAIN(F("loop(): Stop. Время выполнения") +String(millis() - startTime)+" mc/n");
}


void ShowFPS()
{
	static uint32_t tm_m = 0;
	static uint32_t cnt_m = 0;
	cnt_m++;
	if ((millis() - tm_m) > 1000)
	{
		Serial.print("loop per sec: "); Serial.println(cnt_m);
		cnt_m = 0;
		tm_m = millis();
	}
}